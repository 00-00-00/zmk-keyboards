## config/west.yml
```yaml
manifest:
  remotes:
    - name: upstream
      url-base: https://github.com/zmkfirmware
  projects:
    - name: zmk
      remote: upstream
      revision: v0.2.1
      import: app/west.yml
  self:
    path: config
```
